## package/batocera/core/batocera-notice/Config.in
```kconfig
config BR2_PACKAGE_BATOCERA_NOTICE
    bool "batocera-notice"
    help
      ProjectArcade pdf notice
```

## package/batocera/emulationstation/batocera-es-web-ui/Config.in
```kconfig
config BR2_PACKAGE_BATOCERA_ES_WEB_UI
        bool "ProjectArcade Web UI"
	depends on BR2_PACKAGE_BATOCERA_EMULATIONSTATION

        help
          A modern Web UI for ProjectArcade remote control
```

## package/batocera/emulationstation/es-background-musics/Config.in
```kconfig
config BR2_PACKAGE_ES_BACKGROUND_MUSICS
        bool "es-background-musics"

        help
         EmulationStation background music
```
